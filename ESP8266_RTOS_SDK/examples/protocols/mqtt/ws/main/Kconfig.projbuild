## ESP8266_RTOS_SDK/examples/protocols/mqtt/ws/main/Kconfig.projbuild
```kconfig
menu "Example Configuration"

    config BROKER_URI
        string "Broker URL"
        default "ws://localhost:8888"
        help
            URL of an mqtt broker which this example connects to.

endmenu
```
